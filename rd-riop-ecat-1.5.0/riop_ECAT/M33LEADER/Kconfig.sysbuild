## rd-riop-ecat-1.5.0/riop_ECAT/M33LEADER/Kconfig.sysbuild
```kconfig
#
# Copyright 2024 NXP
#
# SPDX-License-Identifier: BSD-3-Clause

# setting CM7 build configuration to debug for all CM33 build configurations
config secondary_config
    string
    default "debug" if $(config) = "flexspi_nor_debug"
    default "debug" if $(config) = "flexspi_nor_release"
    default "debug" if $(config) = "debug"
    default "debug" if $(config) = "release"

rsource "${SdkRootDirPath}/examples/multicore_examples/Kconfig.sysbuild"
```
